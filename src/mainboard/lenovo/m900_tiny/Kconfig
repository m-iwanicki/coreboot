## src/mainboard/lenovo/m900_tiny/Kconfig
```kconfig
# SPDX-License-Identifier: GPL-2.0-only

if BOARD_LENOVO_THINKCENTRE_M900_TINY

config BOARD_SPECIFIC_OPTIONS
	def_bool y
	select BOARD_ROMSIZE_KB_16384
	select HAVE_ACPI_RESUME
	select HAVE_ACPI_TABLES
	select HAVE_CMOS_DEFAULT
	select HAVE_OPTION_TABLE
	select INTEL_GMA_HAVE_VBT
	select INTEL_INT15
	select MAINBOARD_HAS_LIBGFXINIT
	select MAINBOARD_USES_IFD_GBE_REGION
	select SKYLAKE_SOC_PCH_H
	select SOC_INTEL_COMMON_BLOCK_HDA_VERB
	select SOC_INTEL_KABYLAKE
	select SUPERIO_NUVOTON_NCT6687D
	select NO_UART_ON_SUPERIO
	select INTEL_LPSS_UART_FOR_CONSOLE
	select INTEL_HAS_TOP_SWAP

config BOOTBLOCK_IN_CBFS
	default n

choice PLATFORM_TPM_CHOICE
	prompt "Preferred TPM type"
	default USE_DTPM

config USE_DTPM
	bool "Discrete TPM 1.2"
	select MAINBOARD_HAS_TPM1
	select MEMORY_MAPPED_TPM

config USE_PTT
	bool "Intel Platform Trust Technology"
	select MAINBOARD_HAS_TPM2
	select CRB_TPM
	select HAVE_INTEL_PTT

endchoice

config OVERRIDE_DEVICETREE
	default "ptt.cb" if USE_PTT
	default "dtpm.cb"

config UART_FOR_CONSOLE
	int
	default 2 if INTEL_LPSS_UART_FOR_CONSOLE
	default 0

config MAINBOARD_DIR
	default "lenovo/m900_tiny"

config MAINBOARD_PART_NUMBER
	default "ThinkCentre M700 / M900 Tiny"

config PRERAM_CBMEM_CONSOLE_SIZE
	hex
	default 0xd00

config DIMM_SPD_SIZE
	default 512 #DDR4

# TODO: fix and enable
config DRIVER_LENOVO_SERIALS
	bool
	default n

endif
```
